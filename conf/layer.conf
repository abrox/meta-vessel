## conf/layer.conf
```bitbake
# We have a conf and classes directory, add to BBPATH
BBPATH .= ":${LAYERDIR}"

# We have recipes-* directories, add to BBFILES
BBFILES += "${LAYERDIR}/recipes-*/*/*.bb \
            ${LAYERDIR}/recipes-*/*/*.bbappend"

BBFILE_COLLECTIONS += "meta-vessel"
BBFILE_PATTERN_meta-vessel = "^${LAYERDIR}/"
BBFILE_PRIORITY_meta-vessel = "20"

LAYERDEPENDS_meta-vessel = "core"
LAYERSERIES_COMPAT_meta-vessel = "warrior"
```
